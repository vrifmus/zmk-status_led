## Kconfig
```kconfig
config STATUS_LED
    bool "Enable STATUS LED for showing battery and output status"

if STATUS_LED

config LED
    default y

config PWM
    default y

config ZMK_BATTERY_REPORTING
    default y

endif # STATUS_LED


DT_COMPAT_ZMK_BEHAVIOR_STATUS_LED := zmk,behavior-statud-led

config ZMK_BEHAVIOR_STATUS_LED
    bool
    default $(dt_compat_enabled,$(DT_COMPAT_ZMK_BEHAVIOR_STATUS_LED))
```

## dts/bindings/behaviors/zmk,status-led.yaml
```yaml
description: Satus LED indicator behavior

compatible: "zmk,behavior-status-led"

include: zero_param.yaml

properties:
  indicate-battery:
    type: boolean
```
